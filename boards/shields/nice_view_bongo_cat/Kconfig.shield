## boards/shields/nice_view_bongo_cat/Kconfig.shield
```kconfig
# Copyright (c) 2022 The ZMK Contributors
# SPDX-License-Identifier: MIT

config SHIELD_NICE_VIEW_BONGO_CAT
    def_bool $(shields_list_contains,nice_view_bongo_cat)
```

## config/west.yml
```yaml
# manifest:
#   remotes:
#     - name: zmkfirmware
#       url-base: https://github.com/zmkfirmware
#     # Additional modules containing boards/shields/custom code can be listed here as well
#     # See https://docs.zephyrproject.org/3.2.0/develop/west/manifest.html#projects
#   projects:
#     - name: zmk
#       remote: zmkfirmware
#       revision: main
#       import: app/west.yml
#   self:
#     path: config

manifest:
  remotes:
    # zmk official
    - name: zmkfirmware
      url-base: https://github.com/zmkfirmware
    - name: MrBanh                              # new entry
      url-base: https://github.com/MrBanh       # new entry
    - name: m165437                             #new entry
      url-base: https://github.com/M165437      #new entry
    - name: gpeye                               #new entry
      url-base: https://github.com/GPeye        #new entry
    - name: infely                              # new entry
      url-base: https://github.com/infely       # new entry

  projects:
    - name: zmk
      remote: zmkfirmware
      revision: main
      import: app/west.yml
# Add this below
    - name: nice-view-mod                 #new entry
      remote: gpeye                       #new entry
      revision: main                      #new entry
    - name: nice-view-bongo-cat           # repo name
      remote: MrBanh
      revision: main                      # branch
    - name: nice-view-gem                 #new entry
      remote: m165437                     #new entry
      revision: main                      #new
    - name: hammerbeam-slideshow          #new entry
      remote: gpeye                       #new entry
      revision: main                      #new entry
    - name: nice-view-battery             # new entry
      remote: infely                      # new entry
      revision: main                      # new entry
  self:
    path: config
```
